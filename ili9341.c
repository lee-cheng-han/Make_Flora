#include "ili9341.h"
#include <stdlib.h>
#include <string.h>

static SPI_HandleTypeDef *lcd_spi;

/* 5x7 Font Definitions */
static const uint8_t font5x7[][5] = {
  {0x00,0x00,0x00,0x00,0x00},{0x00,0x00,0x5F,0x00,0x00},
  {0x00,0x07,0x00,0x07,0x00},{0x14,0x7F,0x14,0x7F,0x14},
  {0x24,0x2A,0x7F,0x2A,0x12},{0x23,0x13,0x08,0x64,0x62},
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  {0x00,0x41,0x36,0x08,0x00},{0x10,0x08,0x08,0x10,0x08},
};

static inline void CS_LOW(void)  { HAL_GPIO_WritePin(LCD_CS_PORT, LCD_CS_PIN, GPIO_PIN_RESET); }
static inline void CS_HIGH(void) { HAL_GPIO_WritePin(LCD_CS_PORT, LCD_CS_PIN, GPIO_PIN_SET); }
static inline void DC_CMD(void)  { HAL_GPIO_WritePin(LCD_DC_PORT, LCD_DC_PIN, GPIO_PIN_RESET); }
static inline void DC_DATA(void) { HAL_GPIO_WritePin(LCD_DC_PORT, LCD_DC_PIN, GPIO_PIN_SET); }
static inline void RST_LOW(void) { HAL_GPIO_WritePin(LCD_RST_PORT, LCD_RST_PIN, GPIO_PIN_RESET); }
static inline void RST_HIGH(void){ HAL_GPIO_WritePin(LCD_RST_PORT, LCD_RST_PIN, GPIO_PIN_SET); }

static void LCD_WriteCmd(uint8_t cmd) {
  DC_CMD(); CS_LOW();
  HAL_SPI_Transmit(lcd_spi, &cmd, 1, HAL_MAX_DELAY);
  CS_HIGH();
}

static void LCD_WriteData8(uint8_t data) {
  DC_DATA(); CS_LOW();
  HAL_SPI_Transmit(lcd_spi, &data, 1, HAL_MAX_DELAY);
  CS_HIGH();
}

static void LCD_WriteData16(uint16_t data) {
  uint8_t buf[2] = { data >> 8, data & 0xFF };
  DC_DATA(); CS_LOW();
  HAL_SPI_Transmit(lcd_spi, buf, 2, HAL_MAX_DELAY);
  CS_HIGH();
}

static void LCD_SetWindow(uint16_t x0, uint16_t y0, uint16_t x1, uint16_t y1) {
  LCD_WriteCmd(0x2A);
  LCD_WriteData16(x0); LCD_WriteData16(x1);
  LCD_WriteCmd(0x2B);
  LCD_WriteData16(y0); LCD_WriteData16(y1);
  LCD_WriteCmd(0x2C);
}

void LCD_Init(SPI_HandleTypeDef *hspi) {
  lcd_spi = hspi;

  RST_HIGH(); HAL_Delay(5);
  RST_LOW();  HAL_Delay(20);
  RST_HIGH(); HAL_Delay(150);

  LCD_WriteCmd(0x01); HAL_Delay(150);

  LCD_WriteCmd(0xCB);
  LCD_WriteData8(0x39); LCD_WriteData8(0x2C);
  LCD_WriteData8(0x00); LCD_WriteData8(0x34); LCD_WriteData8(0x02);
  LCD_WriteCmd(0xCF);
  LCD_WriteData8(0x00); LCD_WriteData8(0xC1); LCD_WriteData8(0x30);
  LCD_WriteCmd(0xE8);
  LCD_WriteData8(0x85); LCD_WriteData8(0x00); LCD_WriteData8(0x78);
  LCD_WriteCmd(0xEA);
  LCD_WriteData8(0x00); LCD_WriteData8(0x00);
  LCD_WriteCmd(0xED);
  LCD_WriteData8(0x64); LCD_WriteData8(0x03);
  LCD_WriteData8(0x12); LCD_WriteData8(0x81);
  LCD_WriteCmd(0xF7); LCD_WriteData8(0x20);
  LCD_WriteCmd(0xC0); LCD_WriteData8(0x23);
  LCD_WriteCmd(0xC1); LCD_WriteData8(0x10);
  LCD_WriteCmd(0xC5); LCD_WriteData8(0x3E); LCD_WriteData8(0x28);
  LCD_WriteCmd(0xC7); LCD_WriteData8(0x86);

  /* Set rotation explicitly via SetRotation() later */
  
  LCD_WriteCmd(0x3A); LCD_WriteData8(0x55);
  LCD_WriteCmd(0xB1); LCD_WriteData8(0x00); LCD_WriteData8(0x18);
  LCD_WriteCmd(0xB6); LCD_WriteData8(0x08); LCD_WriteData8(0x82); LCD_WriteData8(0x27);

  LCD_WriteCmd(0x11); HAL_Delay(120);
  LCD_WriteCmd(0x29); HAL_Delay(50);
}

/* * 修正版 SetRotation (Color Fix)
 * Case 0: 0x20 (MV=1, BGR=0)
 * 作用: 
 * - MV=1: 交换X/Y轴，保证竖屏方向正确（解决雪花问题）。
 * - BGR=0: 设为 RGB 模式，解决“红变蓝”问题。
 */
void LCD_SetRotation(uint8_t r) {
  LCD_WriteCmd(0x36);
  uint8_t val = 0;

  switch (r % 4) {
    case 0: // 竖屏 - FIXED COLOR
      val = 0x20; // 仅保留 MV 位，去掉 BGR(0x08)
      break;

    case 1: // 横屏
      val = 0x20 | 0x08; // 保持原有逻辑测试 (如果横屏也要修颜色，去掉 0x08)
      break;
    case 2: // 竖屏翻转
      val = 0x80 | 0x40 | 0x20; 
      break;
    case 3: // 横屏翻转
      val = 0xE0;
      break;
  }
  LCD_WriteData8(val);
}

void LCD_FillScreen(uint16_t color) { LCD_FillRect(0, 0, LCD_W, LCD_H, color); }

void LCD_DrawPixel(int16_t x, int16_t y, uint16_t color) {
  if (x < 0 || x >= LCD_W || y < 0 || y >= LCD_H) return;
  LCD_SetWindow(x, y, x, y);
  LCD_WriteData16(color);
}

void LCD_FillRect(int16_t x, int16_t y, int16_t w, int16_t h, uint16_t color) {
  if (x >= LCD_W || y >= LCD_H || w <= 0 || h <= 0) return;
  if (x < 0) { w += x; x = 0; }
  if (y < 0) { h += y; y = 0; }
  if (x + w > LCD_W) w = LCD_W - x;
  if (y + h > LCD_H) h = LCD_H - y;

  LCD_SetWindow(x, y, x + w - 1, y + h - 1);

  uint8_t buf[256]; 
  uint8_t hi = color >> 8, lo = color & 0xFF;
  for (int i = 0; i < 128; i++) { buf[i*2] = hi; buf[i*2+1] = lo; }

  int32_t total = (int32_t)w * h;
  DC_DATA(); CS_LOW();
  while (total > 0) {
    int chunk = (total > 128) ? 128 : total;
    HAL_SPI_Transmit(lcd_spi, buf, chunk * 2, HAL_MAX_DELAY);
    total -= chunk;
  }
  CS_HIGH();
}

void LCD_DrawHLine(int16_t x, int16_t y, int16_t w, uint16_t color) { LCD_FillRect(x, y, w, 1, color); }
void LCD_DrawVLine(int16_t x, int16_t y, int16_t h, uint16_t color) { LCD_FillRect(x, y, 1, h, color); }

void LCD_DrawRect(int16_t x, int16_t y, int16_t w, int16_t h, uint16_t color) {
  LCD_DrawHLine(x, y, w, color); LCD_DrawHLine(x, y+h-1, w, color);
  LCD_DrawVLine(x, y, h, color); LCD_DrawVLine(x+w-1, y, h, color);
}

void LCD_DrawLine(int16_t x0, int16_t y0, int16_t x1, int16_t y1, uint16_t color) {
  int16_t dx = abs(x1-x0), sx = x0<x1?1:-1;
  int16_t dy = -abs(y1-y0), sy = y0<y1?1:-1;
  int16_t err = dx+dy, e2;
  while (1) {
    LCD_DrawPixel(x0, y0, color);
    if (x0==x1 && y0==y1) break;
    e2 = 2*err;
    if (e2 >= dy) { err += dy; x0 += sx; }
    if (e2 <= dx) { err += dx; y0 += sy; }
  }
}

void LCD_DrawChar(int16_t x, int16_t y, char c, uint16_t color, uint16_t bg, uint8_t size) {
  if (c < 32 || c > 126) c = '?';
  int idx = c - 32;
  for (uint8_t col = 0; col < 5; col++) {
    uint8_t line = font5x7[idx][col];
    for (uint8_t row = 0; row < 7; row++) {
      uint16_t clr = (line & (1 << row)) ? color : bg;
      if (size == 1) LCD_DrawPixel(x+col, y+row, clr);
      else LCD_FillRect(x+col*size, y+row*size, size, size, clr);
    }
  }
  if (size == 1) { for (uint8_t row=0;row<7;row++) LCD_DrawPixel(x+5,y+row,bg); }
  else LCD_FillRect(x+5*size, y, size, 7*size, bg);
}

void LCD_DrawString(int16_t x, int16_t y, const char *str, uint16_t color, uint16_t bg, uint8_t size) {
  while (*str) { LCD_DrawChar(x, y, *str++, color, bg, size); x += 6*size; }
}